## conf/layer.conf
```bitbake
# Layer metadata
BBPATH .= ":${LAYERDIR}"
BBFILES += "${LAYERDIR}/recipes-*/*/*.bb \
            ${LAYERDIR}/recipes-*/*/*.bbappend"

BBFILE_COLLECTIONS += "clang-sdk-layer"
BBFILE_PATTERN_clang-sdk-layer := "^${LAYERDIR}/"
BBFILE_PRIORITY_clang-sdk-layer = "6"

# Yocto version compatibility
LAYERSERIES_COMPAT_clang-sdk-layer = "walnascar"

# Layer dependencies
LAYERDEPENDS_clang-sdk-layer = "core clang-layer"
```
